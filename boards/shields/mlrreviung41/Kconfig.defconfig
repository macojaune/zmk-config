## boards/shields/mlrreviung41/Kconfig.defconfig
```kconfig
# Copyright (c) 2020 The ZMK Contributors
# SPDX-License-Identifier: MIT

if SHIELD_MLRREVIUNG41

config ZMK_KEYBOARD_NAME
    default "MLRReviung41"

endif
```

## boards/shields/mlrreviung41/Kconfig.shield
```kconfig
# Copyright (c) 2020 The ZMK Contributors
# SPDX-License-Identifier: MIT

config SHIELD_MLRREVIUNG41
    def_bool $(shields_list_contains,mlrreviung41)
```
